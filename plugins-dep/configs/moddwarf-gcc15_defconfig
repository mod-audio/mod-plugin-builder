## plugins-dep/configs/moddwarf-gcc15_defconfig
```kconfig
BR2_aarch64=y
BR2_cortex_a35=y
BR2_TOOLCHAIN_EXTERNAL=y
BR2_TOOLCHAIN_EXTERNAL_CUSTOM=y
BR2_TOOLCHAIN_EXTERNAL_PATH="$(TOOLCHAIN_PATH)"
BR2_TOOLCHAIN_EXTERNAL_CUSTOM_PREFIX="aarch64-modaudio-linux-gnu"
BR2_TOOLCHAIN_EXTERNAL_GCC_15=y
BR2_TOOLCHAIN_EXTERNAL_HEADERS_4_4=y
BR2_TOOLCHAIN_EXTERNAL_CUSTOM_GLIBC=y
# BR2_TOOLCHAIN_EXTERNAL_INET_RPC is not set
BR2_TOOLCHAIN_EXTERNAL_CXX=y
BR2_TOOLCHAIN_EXTERNAL_FORTRAN=y
BR2_TOOLCHAIN_EXTERNAL_OPENMP=y
BR2_TARGET_OPTIMIZATION="-march=armv8-a+aes+crc+crypto+sha2 -mcpu=cortex-a35 -mtune=cortex-a35 -mno-fix-cortex-a53-835769 -mno-fix-cortex-a53-843419 -ffast-math -fno-finite-math-only -fomit-frame-pointer -D__MOD_DEVICES__ -D_MOD_DEVICE_DWARF -static-libstdc++ -Wl,-O1,--as-needed,--strip-all"
BR2_TARGET_LDFLAGS="-static-libstdc++ -Wl,-O1,--as-needed,--strip-all"
BR2_DL_DIR="$(DOWNLOAD_PATH)"
BR2_OPTIMIZE_3=y
BR2_SSP_NONE=y
BR2_RELRO_NONE=y
BR2_FORTIFY_SOURCE_NONE=y
BR2_TARGET_GENERIC_HOSTNAME=""
BR2_TARGET_GENERIC_ISSUE=""
BR2_INIT_NONE=y
BR2_ROOTFS_DEVICE_CREATION_DYNAMIC_EUDEV=y
BR2_ROOTFS_DEVICE_TABLE=""
BR2_ROOTFS_MERGED_USR=y
BR2_GENERATE_LOCALE="en_US.UTF-8"
# BR2_PACKAGE_BUSYBOX is not set
BR2_PACKAGE_ALSA_LIB_PCM_PLUGINS=""
BR2_PACKAGE_ALSA_LIB_CTL_PLUGINS=""
BR2_PACKAGE_LIBLO=y
BR2_PACKAGE_LIBSAMPLERATE=y
BR2_PACKAGE_LILV=y
BR2_PACKAGE_CAIRO=y
BR2_PACKAGE_CAIRO_PNG=y
BR2_PACKAGE_NE10=y
BR2_PACKAGE_LIBXML2=y
BR2_PACKAGE_MXML=y
BR2_PACKAGE_EIGEN=y
BR2_PACKAGE_FFTW=y
BR2_PACKAGE_FFTW_SINGLE=y
BR2_PACKAGE_FFTW_DOUBLE=y
BR2_PACKAGE_FFTW_FAST=y
BR2_PACKAGE_LIBGLIB2=y
# BR2_PACKAGE_IFUPDOWN_SCRIPTS is not set
BR2_PACKAGE_UTIL_LINUX_LIBMOUNT=y
BR2_PACKAGE_HOST_CMAKE=y
BR2_PACKAGE_KXSTUDIO_LV2_EXTENSIONS=y
BR2_PACKAGE_LIBMODLA=y
BR2_PACKAGE_MOD_LV2_EXTENSIONS=y
BR2_PACKAGE_MOD_PLUGIN_BUILDER=y
```
