## plugins-dep/package/darkglass-lv2-extensions/Config.in
```kconfig
config BR2_PACKAGE_DARKGLASS_LV2_EXTENSIONS
	bool darkglass-lv2-extensions
	select BR2_PACKAGE_LV2
```

## plugins-dep/package/fluidsynth/Config.in
```kconfig
config BR2_PACKAGE_FLUIDSYNTH
	bool "fluidsynth"
	select BR2_PACKAGE_LIBGLIB2
	select BR2_PACKAGE_LIBSNDFILE
```

## plugins-dep/package/juce-8.0/Config.in
```kconfig
config BR2_PACKAGE_JUCE_8_0
	bool "juce-8.0"
	select BR2_PACKAGE_FREETYPE
	select BR2_PACKAGE_XLIB_LIBX11
```

## plugins-dep/package/kxstudio-lv2-extensions/Config.in
```kconfig
config BR2_PACKAGE_KXSTUDIO_LV2_EXTENSIONS
	bool kxstudio-lv2-extensions
	select BR2_PACKAGE_LV2
```

## plugins-dep/package/libmodla/Config.in
```kconfig
config BR2_PACKAGE_LIBMODLA
	bool "libmodla"

config BR2_PACKAGE_LIBMODLA_PABLITO
	bool "libmodla for pablito"
```

## plugins-dep/package/lv2/Config.in
```kconfig
config BR2_PACKAGE_LV2
	bool "lv2"
	help
	  LV2 is an open standard for audio plugins, used by hundreds
	  of plugins and other projects. At its core, LV2 is a simple
	  stable interface, accompanied by extensions which add
	  functionality to support the needs of increasingly powerful
	  audio software.

	  http://lv2plug.in/
```

## plugins-dep/package/lvtk-1/Config.in
```kconfig
config BR2_PACKAGE_LVTK_1
	bool "lvtk-1"
	select BR2_PACKAGE_BOOST
	select BR2_PACKAGE_LV2
```

## plugins-dep/package/mod-host/Config.in
```kconfig
config BR2_PACKAGE_MOD_HOST
	bool "mod-host"
	select BR2_PACKAGE_FFTW_SINGLE
	select BR2_PACKAGE_FFTW_DOUBLE
	select BR2_PACKAGE_JACK2MOD
	select BR2_PACKAGE_HYLIA
	select BR2_PACKAGE_READLINE
	select BR2_PACKAGE_LILV
```

## plugins-dep/package/mod-ui/Config.in
```kconfig
config BR2_PACKAGE_MOD_UI
	bool "mod-ui"
	select BR2_PACKAGE_PYTHON3
	select BR2_PACKAGE_MOD_HOST
	select BR2_PACKAGE_PYTHON_PILLOW
	select BR2_PACKAGE_PYTHON_PYCRYPTO
	select BR2_PACKAGE_PYTHON_PYSTACHE
	select BR2_PACKAGE_PYTHON_SERIAL
	select BR2_PACKAGE_PYTHON_TORNADO
	select BR2_PACKAGE_PYTHON_SETUPTOOLS
```
