## plugins-dep/package/p7zip-light/Config.in
```kconfig
config BR2_PACKAGE_P7ZIP_LIGHT
	bool "p7zip-light"
	help
	  Command-line version of the 7-Zip compressed file archiver
	  without RAR and GUI support.

	  http://p7zip.sourceforge.net/

if BR2_PACKAGE_P7ZIP_LIGHT

config BR2_PACKAGE_P7ZIP_LIGHT_SFX
	bool "SFX support"
	help
	  Enable support for creating self-extracting archives.

config BR2_PACKAGE_P7ZIP_LIGHT_7ZR
	bool "7zr"
	help
	  Build 7zr executable. Only supports 7z archives.

endif
```

## plugins-dep/package/python-pillow/Config.in
```kconfig
config BR2_PACKAGE_PYTHON_PILLOW
        bool "python-pillow"
        select BR2_PACKAGE_ZLIB
        select BR2_PACKAGE_JPEG
        select BR2_PACKAGE_PNG
        help
          The Python Imaging Library (PIL) adds image processing capabilities to your
          Python interpreter. This library supports many file formats, and provides
          powerful image processing and graphics capabilities.

          http://www.pythonware.com/products/pil/
```

## plugins-dep/package/sord/Config.in
```kconfig
config BR2_PACKAGE_SORD
	bool "sord"
	select BR2_PACKAGE_PCRE
	select BR2_PACKAGE_SERD
```

## plugins-dep/package/sratom/Config.in
```kconfig
config BR2_PACKAGE_SRATOM
	bool "sratom"
	select BR2_PACKAGE_LV2
	select BR2_PACKAGE_SORD
```

## plugins-dep/package/vamp-sdk/Config.in
```kconfig
config BR2_PACKAGE_VAMP_SDK
	bool "vamp-sdk"
	select BR2_PACKAGE_LIBGLIB2
	select BR2_PACKAGE_LIBSNDFILE
```

## plugins-dep/package/zita-convolver/Config.in
```kconfig
config BR2_PACKAGE_ZITA_CONVOLVER
	bool "zita-convolver"
	select BR2_PACKAGE_FFMPEG
	select BR2_PACKAGE_FFTWF
```

## plugins-dep/package/zita-resampler/Config.in
```kconfig
config BR2_PACKAGE_ZITA_RESAMPLER
	bool "zita-resampler"
	select BR2_PACKAGE_FFTWF
```
