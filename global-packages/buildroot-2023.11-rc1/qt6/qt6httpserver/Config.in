## global-packages/buildroot-2023.11-rc1/qt6/qt6httpserver/Config.in
```kconfig
config BR2_PACKAGE_QT6HTTPSERVER
	bool "qt6httpserver"
	select BR2_PACKAGE_QT6WEBSOCKETS
```

## global-packages/buildroot-2023.11-rc1/qt6/qt6websockets/Config.in
```kconfig
config BR2_PACKAGE_QT6WEBSOCKETS
	bool "qt6websockets"
# 	select BR2_PACKAGE_QT6QUICK
```

## global-packages/buildroot-2023.11.3/qt6/qt6declarative/Config.in
```kconfig
config BR2_PACKAGE_QT6DECLARATIVE
	bool "qt6declarative"
	select BR2_PACKAGE_QT6SHADERTOOLS
```

## global-packages/buildroot-2023.11.3/qt6/qt6shadertools/Config.in
```kconfig
config BR2_PACKAGE_QT6SHADERTOOLS
	bool "qt6shadertools"
	select BR2_PACKAGE_QT6BASE_GUI
	select BR2_PACKAGE_QT6BASE_OPENGL if BR2_PACKAGE_QT6_GL_SUPPORTS
```

## kernel/Config.in
```kconfig
config BR2_VERSION_2016_02
    bool
  	default y if BR2_VERSION = "2016.02"

config BR2_EXTERNAL_KERNEL
    string
    option env="BR2_EXTERNAL_KERNEL"
```

## kernel/configs/moddwarf_defconfig
```kconfig
BR2_aarch64=y
BR2_cortex_a35=y
BR2_DL_DIR="$(DOWNLOAD_PATH)"
BR2_OPTIMIZE_3=y
BR2_TOOLCHAIN_EXTERNAL=y
BR2_TOOLCHAIN_EXTERNAL_PATH="$(TOOLCHAIN_PATH)"
BR2_TOOLCHAIN_EXTERNAL_CUSTOM_PREFIX="aarch64-modaudio-linux-gnu"
BR2_TOOLCHAIN_EXTERNAL_GCC_9=y
BR2_TOOLCHAIN_EXTERNAL_HEADERS_4_4=y
BR2_TOOLCHAIN_EXTERNAL_CUSTOM_GLIBC=y
BR2_TOOLCHAIN_EXTERNAL_CXX=y
BR2_GENERATE_LOCALE="en_US.UTF-8"
BR2_TARGET_OPTIMIZATION="-mcpu=cortex-a35 -mtune=cortex-a35 -mno-fix-cortex-a53-835769 -mno-fix-cortex-a53-843419 -fomit-frame-pointer -D__MOD_DEVICES__ -D_MOD_DEVICE_DWARF"
BR2_TARGET_GENERIC_HOSTNAME=""
BR2_TARGET_GENERIC_ISSUE=""
BR2_INIT_NONE=y
BR2_ROOTFS_DEVICE_CREATION_STATIC=y
BR2_ROOTFS_DEVICE_TABLE=""
BR2_ROOTFS_STATIC_DEVICE_TABLE=""
BR2_ROOTFS_SKELETON_CUSTOM=y
BR2_ROOTFS_SKELETON_CUSTOM_PATH="/tmp/skeleton"
BR2_ROOTFS_POST_BUILD_SCRIPT="$(BR2_EXTERNAL)/board/$(BR2_PLATFORM)/post-build.sh"
BR2_LINUX_KERNEL=y
BR2_LINUX_KERNEL_CUSTOM_GIT=y
BR2_LINUX_KERNEL_CUSTOM_REPO_URL="git@github.com:moddevices/linux-mainline.git"
BR2_LINUX_KERNEL_CUSTOM_REPO_VERSION="cbce1363d7f6a66636123dcae3de20db8c9429d2"
BR2_LINUX_KERNEL_PATCH="$(BR2_EXTERNAL)/board/$(BR2_PLATFORM)/patches"
BR2_LINUX_KERNEL_USE_CUSTOM_CONFIG=y
BR2_LINUX_KERNEL_CUSTOM_CONFIG_FILE="$(BR2_EXTERNAL)/board/$(BR2_PLATFORM)/linux.config"
BR2_LINUX_KERNEL_DTS_SUPPORT=y
BR2_LINUX_KERNEL_USE_CUSTOM_DTS=y
BR2_LINUX_KERNEL_CUSTOM_DTS_PATH="$(BR2_EXTERNAL)/board/$(BR2_PLATFORM)/dts/$(BR2_PLATFORM).dts"
# BR2_PACKAGE_BUSYBOX is not set
# BR2_TARGET_ROOTFS_TAR is not set
```

## plugins-dep/Config.in
```kconfig
config BR2_VERSION_2016_02
    bool
  	default y if !BR2_VERSION

config BR2_EXTERNAL_PLUGINS_DEP
    string
    option env="BR2_EXTERNAL_PLUGINS_DEP"

source "$BR2_EXTERNAL_PLUGINS_DEP/package/carla-backend/Config.in"
source "$BR2_EXTERNAL_PLUGINS_DEP/package/hylia/Config.in"
source "$BR2_EXTERNAL_PLUGINS_DEP/package/jack2mod/Config.in"
source "$BR2_EXTERNAL_PLUGINS_DEP/package/juce-6.0/Config.in"
source "$BR2_EXTERNAL_PLUGINS_DEP/package/juce-6.1/Config.in"
source "$BR2_EXTERNAL_PLUGINS_DEP/package/juce-7.0/Config.in"
source "$BR2_EXTERNAL_PLUGINS_DEP/package/kxstudio-lv2-extensions/Config.in"
source "$BR2_EXTERNAL_PLUGINS_DEP/package/libgig/Config.in"
source "$BR2_EXTERNAL_PLUGINS_DEP/package/libmodla/Config.in"
source "$BR2_EXTERNAL_PLUGINS_DEP/package/mod-lv2-extensions/Config.in"
source "$BR2_EXTERNAL_PLUGINS_DEP/package/mod-plugin-builder/Config.in"
source "$BR2_EXTERNAL_PLUGINS_DEP/package/p7zip-light/Config.in"
source "$BR2_EXTERNAL_PLUGINS_DEP/package/python-pystache/Config.in"
source "$BR2_EXTERNAL_PLUGINS_DEP/package/zita-convolver/Config.in"
source "$BR2_EXTERNAL_PLUGINS_DEP/package/zita-resampler/Config.in"

source "$BR2_EXTERNAL_PLUGINS_DEP/package-legacy/fluidsynth/Config.in"
source "$BR2_EXTERNAL_PLUGINS_DEP/package-legacy/lilv/Config.in"
source "$BR2_EXTERNAL_PLUGINS_DEP/package-legacy/lv2/Config.in"
source "$BR2_EXTERNAL_PLUGINS_DEP/package-legacy/lvtk/Config.in"
source "$BR2_EXTERNAL_PLUGINS_DEP/package-legacy/lvtk-1/Config.in"
source "$BR2_EXTERNAL_PLUGINS_DEP/package-legacy/opus-custom/Config.in"
source "$BR2_EXTERNAL_PLUGINS_DEP/package-legacy/python-pillow/Config.in"
source "$BR2_EXTERNAL_PLUGINS_DEP/package-legacy/serd/Config.in"
source "$BR2_EXTERNAL_PLUGINS_DEP/package-legacy/sord/Config.in"
source "$BR2_EXTERNAL_PLUGINS_DEP/package-legacy/sratom/Config.in"
```

## plugins-dep/configs/amd64_defconfig
```kconfig
BR2_x86_64=y
BR2_x86_core2=y
BR2_DL_DIR="$(DOWNLOAD_PATH)"
BR2_OPTIMIZE_3=y
BR2_TOOLCHAIN_EXTERNAL=y
BR2_TOOLCHAIN_EXTERNAL_CUSTOM=y
BR2_TOOLCHAIN_EXTERNAL_PATH="$(TOOLCHAIN_PATH)"
BR2_TOOLCHAIN_EXTERNAL_CUSTOM_PREFIX="x86_64-mod-linux-gnu"
BR2_TOOLCHAIN_EXTERNAL_GCC_4_9=y
BR2_TOOLCHAIN_EXTERNAL_HEADERS_4_2=y
BR2_TOOLCHAIN_EXTERNAL_CUSTOM_GLIBC=y
BR2_TOOLCHAIN_EXTERNAL_CXX=y
BR2_TARGET_OPTIMIZATION="-ffast-math -mtune=generic -msse -msse2 -mfpmath=sse -fno-finite-math-only -D__MOD_DEVICES__"
BR2_TARGET_GENERIC_HOSTNAME=""
BR2_TARGET_GENERIC_ISSUE=""
BR2_INIT_NONE=y
BR2_ROOTFS_DEVICE_CREATION_STATIC=y
BR2_ROOTFS_DEVICE_TABLE=""
BR2_ROOTFS_STATIC_DEVICE_TABLE=""
BR2_ROOTFS_SKELETON_CUSTOM=y
BR2_ROOTFS_SKELETON_CUSTOM_PATH="/tmp/skeleton"
# BR2_PACKAGE_BUSYBOX is not set
BR2_PACKAGE_AUDIOFILE=y
BR2_PACKAGE_LIBLO=y
BR2_PACKAGE_LIBXML2=y
BR2_PACKAGE_MXML=y
BR2_PACKAGE_ARMADILLO=y
BR2_PACKAGE_BOOST_ATOMIC=y
BR2_PACKAGE_BOOST_CHRONO=y
BR2_PACKAGE_BOOST_CONTAINER=y
BR2_PACKAGE_BOOST_CONTEXT=y
BR2_PACKAGE_BOOST_DATE_TIME=y
BR2_PACKAGE_BOOST_EXCEPTION=y
BR2_PACKAGE_BOOST_FILESYSTEM=y
BR2_PACKAGE_BOOST_GRAPH=y
BR2_PACKAGE_BOOST_GRAPH_PARALLEL=y
BR2_PACKAGE_BOOST_IOSTREAMS=y
BR2_PACKAGE_BOOST_LOCALE=y
BR2_PACKAGE_BOOST_MATH=y
BR2_PACKAGE_BOOST_MPI=y
BR2_PACKAGE_BOOST_PROGRAM_OPTIONS=y
BR2_PACKAGE_BOOST_RANDOM=y
BR2_PACKAGE_BOOST_REGEX=y
BR2_PACKAGE_BOOST_SERIALIZATION=y
BR2_PACKAGE_BOOST_SIGNALS=y
BR2_PACKAGE_BOOST_SYSTEM=y
BR2_PACKAGE_BOOST_TEST=y
BR2_PACKAGE_BOOST_THREAD=y
BR2_PACKAGE_BOOST_TIMER=y
BR2_PACKAGE_BOOST_WAVE=y
BR2_PACKAGE_EIGEN=y
BR2_PACKAGE_GLIBMM=y
BR2_PACKAGE_ICU=y
BR2_PACKAGE_PCRE=y
BR2_PACKAGE_PCRE_16=y
BR2_PACKAGE_ACL=y
BR2_PACKAGE_DPF=y
BR2_PACKAGE_FLUIDSYNTH=y
BR2_PACKAGE_LIBGIG=y
BR2_PACKAGE_LIBPD=y
BR2_PACKAGE_LVTK=y
BR2_PACKAGE_LVTK_1=y
BR2_PACKAGE_MOD_UI=y
BR2_PACKAGE_ZITA_CONVOLVER=y
BR2_PACKAGE_ZITA_RESAMPLER=y
```

## plugins-dep/configs/darkglass-anagram_defconfig
```kconfig
BR2_aarch64=y
BR2_cortex_a76=y
BR2_TOOLCHAIN_EXTERNAL=y
BR2_TOOLCHAIN_EXTERNAL_CUSTOM=y
BR2_TOOLCHAIN_EXTERNAL_PATH="$(TOOLCHAIN_PATH)"
BR2_TOOLCHAIN_EXTERNAL_CUSTOM_PREFIX="aarch64-modaudio.generic-linux-gnu"
BR2_TOOLCHAIN_EXTERNAL_GCC_9=y
BR2_TOOLCHAIN_EXTERNAL_HEADERS_5_10=y
BR2_TOOLCHAIN_EXTERNAL_CUSTOM_GLIBC=y
# BR2_TOOLCHAIN_EXTERNAL_INET_RPC is not set
BR2_TOOLCHAIN_EXTERNAL_CXX=y
BR2_TOOLCHAIN_EXTERNAL_FORTRAN=y
BR2_TOOLCHAIN_EXTERNAL_OPENMP=y
BR2_TARGET_OPTIMIZATION="-march=armv8.2-a -mcpu=cortex-a76 -mtune=cortex-a76 -ffast-math -fno-finite-math-only -fomit-frame-pointer -D__MOD_DEVICES__ -D_MOD_DEVICE_RK358x -D_DARKGLASS_DEVICE_PABLITO -Wl,-O1,--as-needed,--strip-all"
BR2_TARGET_LDFLAGS="-Wl,-O1,--as-needed,--strip-all"
BR2_DL_DIR="$(DOWNLOAD_PATH)"
BR2_OPTIMIZE_3=y
BR2_SSP_NONE=y
BR2_RELRO_NONE=y
BR2_FORTIFY_SOURCE_NONE=y
BR2_TARGET_GENERIC_HOSTNAME=""
BR2_TARGET_GENERIC_ISSUE=""
BR2_INIT_NONE=y
BR2_ROOTFS_DEVICE_CREATION_DYNAMIC_EUDEV=y
BR2_ROOTFS_DEVICE_TABLE=""
BR2_ROOTFS_MERGED_USR=y
BR2_GENERATE_LOCALE="en_US.UTF-8"
# BR2_PACKAGE_BUSYBOX is not set
BR2_PACKAGE_FFMPEG=y
# BR2_PACKAGE_FFMPEG_FFMPEG is not set
BR2_PACKAGE_FFMPEG_SWSCALE=y
# BR2_PACKAGE_FFMPEG_INDEVS is not set
# BR2_PACKAGE_FFMPEG_OUTDEVS is not set
BR2_PACKAGE_FLAC=y
BR2_PACKAGE_BZIP2=y
BR2_PACKAGE_GZIP=y
BR2_PACKAGE_ZSTD=y
BR2_PACKAGE_XORG7=y
BR2_PACKAGE_DBUS=y
BR2_PACKAGE_ALSA_LIB_PCM_PLUGINS=""
BR2_PACKAGE_ALSA_LIB_CTL_PLUGINS=""
BR2_PACKAGE_LIBLO=y
BR2_PACKAGE_LIBVORBIS=y
BR2_PACKAGE_LILV=y
BR2_PACKAGE_OPUS=y
BR2_PACKAGE_SQLITE=y
BR2_PACKAGE_CAIRO=y
BR2_PACKAGE_CAIRO_PNG=y
BR2_PACKAGE_LIBDRM=y
BR2_PACKAGE_LIBINPUT=y
BR2_PACKAGE_LIBSERIALPORT=y
BR2_PACKAGE_NE10=y
BR2_PACKAGE_LIBXML2=y
BR2_PACKAGE_MXML=y
BR2_PACKAGE_FFTW=y
BR2_PACKAGE_FFTW_SINGLE=y
BR2_PACKAGE_FFTW_DOUBLE=y
BR2_PACKAGE_FFTW_FAST=y
BR2_PACKAGE_LIBGLIB2=y
# BR2_PACKAGE_IFUPDOWN_SCRIPTS is not set
BR2_PACKAGE_UTIL_LINUX_LIBMOUNT=y
BR2_PACKAGE_HOST_CMAKE=y
BR2_PACKAGE_JACK2MOD=y
BR2_PACKAGE_KXSTUDIO_LV2_EXTENSIONS=y
BR2_PACKAGE_LIBMODLA=y
BR2_PACKAGE_LIBMODLA_PABLITO=y
BR2_PACKAGE_MOD_LV2_EXTENSIONS=y
BR2_PACKAGE_MOD_PLUGIN_BUILDER=y
```

## plugins-dep/configs/generic-aarch64-a76.a55_defconfig
```kconfig
BR2_aarch64=y
BR2_TOOLCHAIN_EXTERNAL=y
BR2_TOOLCHAIN_EXTERNAL_CUSTOM=y
BR2_TOOLCHAIN_EXTERNAL_PATH="$(TOOLCHAIN_PATH)"
BR2_TOOLCHAIN_EXTERNAL_CUSTOM_PREFIX="aarch64-modaudio.generic-linux-gnu"
BR2_TOOLCHAIN_EXTERNAL_GCC_9=y
BR2_TOOLCHAIN_EXTERNAL_HEADERS_5_10=y
BR2_TOOLCHAIN_EXTERNAL_CUSTOM_GLIBC=y
# BR2_TOOLCHAIN_EXTERNAL_INET_RPC is not set
BR2_TOOLCHAIN_EXTERNAL_CXX=y
BR2_TOOLCHAIN_EXTERNAL_FORTRAN=y
BR2_TOOLCHAIN_EXTERNAL_OPENMP=y
BR2_TARGET_OPTIMIZATION="-mcpu=cortex-a76.cortex-a55 -mtune=cortex-a76.cortex-a55 -ffast-math -fno-finite-math-only -fomit-frame-pointer -fprefetch-loop-arrays -funroll-loops -funsafe-loop-optimizations -D__MOD_DEVICES__ -D_MOD_DEVICE_GENERIC_AARCH64 -Wl,-O1,--as-needed,--strip-all"
BR2_TARGET_LDFLAGS="-Wl,-O1,--as-needed,--strip-all"
BR2_DL_DIR="$(DOWNLOAD_PATH)"
BR2_OPTIMIZE_3=y
BR2_SSP_NONE=y
BR2_RELRO_NONE=y
BR2_FORTIFY_SOURCE_NONE=y
BR2_TARGET_GENERIC_HOSTNAME=""
BR2_TARGET_GENERIC_ISSUE=""
BR2_INIT_NONE=y
BR2_ROOTFS_DEVICE_TABLE=""
BR2_ROOTFS_MERGED_USR=y
BR2_SYSTEM_BIN_SH_NONE=y
# BR2_TARGET_GENERIC_GETTY is not set
# BR2_TARGET_GENERIC_REMOUNT_ROOTFS_RW is not set
BR2_GENERATE_LOCALE="en_US.UTF-8"
# BR2_PACKAGE_BUSYBOX is not set
BR2_PACKAGE_ALSA_LIB=y
BR2_PACKAGE_ALSA_LIB_PCM_PLUGINS=""
BR2_PACKAGE_ALSA_LIB_CTL_PLUGINS=""
BR2_PACKAGE_FFTW=y
BR2_PACKAGE_FFTW_SINGLE=y
BR2_PACKAGE_FFTW_DOUBLE=y
BR2_PACKAGE_FFTW_FAST=y
# BR2_TARGET_ROOTFS_TAR is not set
BR2_PACKAGE_KXSTUDIO_LV2_EXTENSIONS=y
BR2_PACKAGE_MOD_LV2_EXTENSIONS=y
BR2_PACKAGE_MOD_PLUGIN_BUILDER=y
```

## plugins-dep/configs/generic-aarch64_defconfig
```kconfig
BR2_aarch64=y
BR2_DL_DIR="$(DOWNLOAD_PATH)"
BR2_OPTIMIZE_3=y
BR2_TOOLCHAIN_EXTERNAL=y
BR2_TOOLCHAIN_EXTERNAL_CUSTOM=y
BR2_TOOLCHAIN_EXTERNAL_PATH="$(TOOLCHAIN_PATH)"
BR2_TOOLCHAIN_EXTERNAL_CUSTOM_PREFIX="aarch64-modaudio.generic-linux-gnu"
BR2_TOOLCHAIN_EXTERNAL_GCC_9=y
BR2_TOOLCHAIN_EXTERNAL_HEADERS_4_1=y
BR2_TOOLCHAIN_EXTERNAL_CUSTOM_GLIBC=y
# BR2_TOOLCHAIN_EXTERNAL_INET_RPC is not set
BR2_TOOLCHAIN_EXTERNAL_CXX=y
BR2_GENERATE_LOCALE="en_US.UTF-8"
BR2_TARGET_OPTIMIZATION="-march=armv8-a -ffast-math -fno-finite-math-only -fomit-frame-pointer -fprefetch-loop-arrays -funroll-loops -funsafe-loop-optimizations -D__MOD_DEVICES__ -D_MOD_DEVICE_GENERIC_AARCH64 -Wl,-O1,--as-needed,--strip-all"
BR2_TARGET_LDFLAGS="-Wl,-O1,--as-needed,--strip-all"
BR2_TARGET_GENERIC_HOSTNAME=""
BR2_TARGET_GENERIC_ISSUE=""
BR2_INIT_NONE=y
BR2_ROOTFS_DEVICE_CREATION_STATIC=y
BR2_ROOTFS_DEVICE_TABLE=""
BR2_ROOTFS_STATIC_DEVICE_TABLE=""
BR2_ROOTFS_SKELETON_CUSTOM=y
BR2_ROOTFS_SKELETON_CUSTOM_PATH="/tmp/skeleton"
# BR2_PACKAGE_BUSYBOX is not set
BR2_PACKAGE_DIRECTFB=y
BR2_PACKAGE_SDL=y
BR2_PACKAGE_SDL_DIRECTFB=y
BR2_PACKAGE_SDL_GFX=y
BR2_PACKAGE_SDL_IMAGE=y
BR2_PACKAGE_SDL_IMAGE_GIF=y
BR2_PACKAGE_SDL_IMAGE_JPEG=y
BR2_PACKAGE_SDL_IMAGE_PNG=y
BR2_PACKAGE_SDL_TTF=y
BR2_PACKAGE_QT5=y
BR2_PACKAGE_QT5BASE_LICENSE_APPROVED=y
BR2_PACKAGE_QT5BASE_WIDGETS=y
BR2_PACKAGE_QT5BASE_LINUXFB=y
BR2_PACKAGE_QT5BASE_DIRECTFB=y
BR2_PACKAGE_QT5BASE_DEFAULT_QPA="linuxfb"
BR2_PACKAGE_QT5BASE_FONTCONFIG=y
BR2_PACKAGE_QT5BASE_GIF=y
BR2_PACKAGE_QT5BASE_JPEG=y
BR2_PACKAGE_QT5BASE_PNG=y
BR2_PACKAGE_QT5BASE_ICU=y
BR2_PACKAGE_QT5SVG=y
BR2_PACKAGE_ALSA_LIB=y
BR2_PACKAGE_LIBLO=y
BR2_PACKAGE_LIBSAMPLERATE=y
BR2_PACKAGE_LIBUSB=y
BR2_PACKAGE_NE10=y
BR2_PACKAGE_LIBXML2=y
BR2_PACKAGE_MXML=y
BR2_PACKAGE_ARMADILLO=y
BR2_PACKAGE_BOOST_ATOMIC=y
BR2_PACKAGE_BOOST_CHRONO=y
BR2_PACKAGE_BOOST_CONTAINER=y
BR2_PACKAGE_BOOST_DATE_TIME=y
BR2_PACKAGE_BOOST_EXCEPTION=y
BR2_PACKAGE_BOOST_FILESYSTEM=y
BR2_PACKAGE_BOOST_GRAPH=y
BR2_PACKAGE_BOOST_GRAPH_PARALLEL=y
BR2_PACKAGE_BOOST_IOSTREAMS=y
BR2_PACKAGE_BOOST_LOCALE=y
BR2_PACKAGE_BOOST_MATH=y
BR2_PACKAGE_BOOST_MPI=y
BR2_PACKAGE_BOOST_PROGRAM_OPTIONS=y
BR2_PACKAGE_BOOST_RANDOM=y
BR2_PACKAGE_BOOST_REGEX=y
BR2_PACKAGE_BOOST_SERIALIZATION=y
BR2_PACKAGE_BOOST_SIGNALS=y
BR2_PACKAGE_BOOST_SYSTEM=y
BR2_PACKAGE_BOOST_TEST=y
BR2_PACKAGE_BOOST_THREAD=y
BR2_PACKAGE_BOOST_TIMER=y
BR2_PACKAGE_BOOST_WAVE=y
BR2_PACKAGE_EIGEN=y
BR2_PACKAGE_FFTW=y
BR2_PACKAGE_FFTW_DOUBLE=y
BR2_PACKAGE_FFTW_FAST=y
BR2_PACKAGE_GLIBMM=y
BR2_PACKAGE_ACL=y
BR2_PACKAGE_UTIL_LINUX=y
BR2_PACKAGE_UTIL_LINUX_LIBMOUNT=y
# BR2_TARGET_ROOTFS_TAR is not set
BR2_PACKAGE_DPF=y
BR2_PACKAGE_FLUIDSYNTH=y
BR2_PACKAGE_KXSTUDIO_LV2_EXTENSIONS=y
BR2_PACKAGE_LIBGIG=y
BR2_PACKAGE_LIBPD=y
BR2_PACKAGE_LILV=y
BR2_PACKAGE_LVTK=y
BR2_PACKAGE_LVTK_1=y
BR2_PACKAGE_MOD_LV2_EXTENSIONS=y
BR2_PACKAGE_MOD_PLUGIN_BUILDER=y
BR2_PACKAGE_ZITA_CONVOLVER=y
BR2_PACKAGE_ZITA_RESAMPLER=y
```

## plugins-dep/configs/generic-x86_64-debug_defconfig
```kconfig
BR2_x86_64=y
BR2_DL_DIR="$(DOWNLOAD_PATH)"
BR2_STRIP_none=y
BR2_OPTIMIZE_0=y
BR2_TOOLCHAIN_EXTERNAL=y
BR2_TOOLCHAIN_EXTERNAL_CUSTOM=y
BR2_TOOLCHAIN_EXTERNAL_PATH="$(TOOLCHAIN_PATH)"
BR2_TOOLCHAIN_EXTERNAL_CUSTOM_PREFIX="x86_64-modaudio.generic-linux-gnu"
BR2_TOOLCHAIN_EXTERNAL_GCC_9=y
BR2_TOOLCHAIN_EXTERNAL_HEADERS_5_15=y
BR2_TOOLCHAIN_EXTERNAL_CUSTOM_GLIBC=y
# BR2_TOOLCHAIN_EXTERNAL_INET_RPC is not set
BR2_TOOLCHAIN_EXTERNAL_CXX=y
BR2_GENERATE_LOCALE="en_US.UTF-8"
BR2_TARGET_OPTIMIZATION="-mtune=generic -msse -msse2 -mfpmath=sse -ffast-math -fno-finite-math-only -g -D__MOD_DEVICES__ -D_MOD_DEVICE_GENERIC_X86_64"
BR2_TARGET_GENERIC_HOSTNAME=""
BR2_TARGET_GENERIC_ISSUE=""
BR2_INIT_NONE=y
BR2_ROOTFS_DEVICE_CREATION_STATIC=y
BR2_ROOTFS_DEVICE_TABLE=""
BR2_ROOTFS_STATIC_DEVICE_TABLE=""
BR2_ROOTFS_SKELETON_CUSTOM=y
BR2_ROOTFS_SKELETON_CUSTOM_PATH="/tmp/skeleton"
# BR2_PACKAGE_BUSYBOX is not set
BR2_PACKAGE_VALGRIND=y
BR2_PACKAGE_LIBLO=y
BR2_PACKAGE_FFTW=y
BR2_PACKAGE_FFTW_SINGLE=y
BR2_PACKAGE_FFTW_DOUBLE=y
BR2_PACKAGE_FFTW_FAST=y
# BR2_TARGET_ROOTFS_TAR is not set
BR2_PACKAGE_CARLA_BACKEND=y
BR2_PACKAGE_KXSTUDIO_LV2_EXTENSIONS=y
BR2_PACKAGE_LV2=y
BR2_PACKAGE_MOD_LV2_EXTENSIONS=y
BR2_PACKAGE_MOD_PLUGIN_BUILDER=y
```
