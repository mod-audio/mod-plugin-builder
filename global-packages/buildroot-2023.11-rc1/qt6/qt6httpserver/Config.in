## plugins-dep/configs/generic-x86_64_defconfig
```kconfig
BR2_x86_64=y
BR2_TOOLCHAIN_EXTERNAL=y
BR2_TOOLCHAIN_EXTERNAL_CUSTOM=y
BR2_TOOLCHAIN_EXTERNAL_PATH="$(TOOLCHAIN_PATH)"
BR2_TOOLCHAIN_EXTERNAL_CUSTOM_PREFIX="x86_64-modaudio.generic-linux-gnu"
BR2_TOOLCHAIN_EXTERNAL_GCC_9=y
BR2_TOOLCHAIN_EXTERNAL_HEADERS_5_10=y
BR2_TOOLCHAIN_EXTERNAL_CUSTOM_GLIBC=y
# BR2_TOOLCHAIN_EXTERNAL_INET_RPC is not set
BR2_TOOLCHAIN_EXTERNAL_CXX=y
BR2_TOOLCHAIN_EXTERNAL_FORTRAN=y
BR2_TOOLCHAIN_EXTERNAL_OPENMP=y
BR2_TARGET_OPTIMIZATION="-mtune=generic -msse -msse2 -mfpmath=sse -ffast-math -fno-finite-math-only -fomit-frame-pointer -fprefetch-loop-arrays -funroll-loops -funsafe-loop-optimizations -D__MOD_DEVICES__ -D_MOD_DEVICE_GENERIC_X86_64 -Wl,-O1,--as-needed,--strip-all"
BR2_TARGET_LDFLAGS="-Wl,-O1,--as-needed,--strip-all"
BR2_DL_DIR="$(DOWNLOAD_PATH)"
BR2_OPTIMIZE_3=y
BR2_SSP_NONE=y
BR2_RELRO_NONE=y
BR2_FORTIFY_SOURCE_NONE=y
BR2_TARGET_GENERIC_HOSTNAME=""
BR2_TARGET_GENERIC_ISSUE=""
BR2_INIT_NONE=y
BR2_ROOTFS_DEVICE_CREATION_DYNAMIC_EUDEV=y
BR2_ROOTFS_DEVICE_TABLE=""
BR2_ROOTFS_MERGED_USR=y
BR2_GENERATE_LOCALE="en_US.UTF-8"
# BR2_PACKAGE_BUSYBOX is not set
BR2_PACKAGE_FLAC=y
BR2_PACKAGE_FLUIDSYNTH=y
# BR2_PACKAGE_FLUIDSYNTH_ALSA_LIB is not set
BR2_PACKAGE_FLUIDSYNTH_LIBSNDFILE=y
BR2_PACKAGE_FLUIDSYNTH_FLOATS=y
BR2_PACKAGE_BZIP2=y
BR2_PACKAGE_GZIP=y
BR2_PACKAGE_ZSTD=y
BR2_PACKAGE_COG=y
BR2_PACKAGE_COG_PROGRAMS_HOME_URI="http://127.0.0.1/"
BR2_PACKAGE_COG_PLATFORM_DRM=y
BR2_PACKAGE_COG_PLATFORM_X11=y
BR2_PACKAGE_MESA3D=y
BR2_PACKAGE_MESA3D_GALLIUM_DRIVER_SWRAST=y
BR2_PACKAGE_MESA3D_OPENGL_EGL=y
BR2_PACKAGE_MESA3D_OPENGL_ES=y
BR2_PACKAGE_SDL2=y
BR2_PACKAGE_SDL2_KMSDRM=y
BR2_PACKAGE_SDL2_OPENGLES=y
BR2_PACKAGE_SDL2_GFX=y
BR2_PACKAGE_SDL2_IMAGE=y
BR2_PACKAGE_XORG7=y
BR2_PACKAGE_ALSA_LIB=y
BR2_PACKAGE_ALSA_LIB_PCM_PLUGINS=""
BR2_PACKAGE_ALSA_LIB_CTL_PLUGINS=""
BR2_PACKAGE_LIBLO=y
BR2_PACKAGE_LIBSAMPLERATE=y
BR2_PACKAGE_LIBVORBIS=y
BR2_PACKAGE_LILV=y
BR2_PACKAGE_OPUS=y
BR2_PACKAGE_OPENSSL=y
BR2_PACKAGE_WPEWEBKIT=y
BR2_PACKAGE_LIBUSB=y
BR2_PACKAGE_MXML=y
BR2_PACKAGE_ARMADILLO=y
BR2_PACKAGE_EIGEN=y
BR2_PACKAGE_FFTW=y
BR2_PACKAGE_FFTW_DOUBLE=y
BR2_PACKAGE_FFTW_FAST=y
BR2_PACKAGE_GLIBMM2_66=y
# BR2_PACKAGE_IFUPDOWN_SCRIPTS is not set
BR2_PACKAGE_ACL=y
BR2_PACKAGE_UTIL_LINUX_LIBMOUNT=y
BR2_PACKAGE_KXSTUDIO_LV2_EXTENSIONS=y
BR2_PACKAGE_LIBGIG=y
BR2_PACKAGE_MOD_LV2_EXTENSIONS=y
BR2_PACKAGE_MOD_PLUGIN_BUILDER=y
BR2_PACKAGE_ZITA_CONVOLVER=y
BR2_PACKAGE_ZITA_RESAMPLER=y
```

## plugins-dep/configs/modduo-debug_defconfig
```kconfig
BR2_arm=y
BR2_cortex_a7=y
BR2_ARM_FPU_NEON_VFPV4=y
BR2_ARM_INSTRUCTIONS_THUMB2=y
BR2_DL_DIR="$(DOWNLOAD_PATH)"
BR2_STRIP_none=y
BR2_OPTIMIZE_0=y
BR2_TOOLCHAIN_EXTERNAL=y
BR2_TOOLCHAIN_EXTERNAL_CUSTOM=y
BR2_TOOLCHAIN_EXTERNAL_PATH="$(TOOLCHAIN_PATH)"
BR2_TOOLCHAIN_EXTERNAL_CUSTOM_PREFIX="arm-mod-linux-gnueabihf"
BR2_TOOLCHAIN_EXTERNAL_GCC_4_9=y
BR2_TOOLCHAIN_EXTERNAL_HEADERS_3_10=y
BR2_TOOLCHAIN_EXTERNAL_CUSTOM_GLIBC=y
BR2_TOOLCHAIN_EXTERNAL_CXX=y
BR2_TARGET_OPTIMIZATION="-mcpu=cortex-a7 -mtune=cortex-a7 -mfpu=neon-vfpv4 -mfloat-abi=hard -mvectorize-with-neon-quad -ffast-math -fno-finite-math-only -g -D__MOD_DEVICES__ -D_MOD_DEVICE_DUO"
BR2_TARGET_GENERIC_HOSTNAME=""
BR2_TARGET_GENERIC_ISSUE=""
BR2_INIT_NONE=y
BR2_ROOTFS_DEVICE_CREATION_STATIC=y
BR2_ROOTFS_DEVICE_TABLE=""
BR2_ROOTFS_STATIC_DEVICE_TABLE=""
BR2_ROOTFS_SKELETON_CUSTOM=y
BR2_ROOTFS_SKELETON_CUSTOM_PATH="/tmp/skeleton"
# BR2_PACKAGE_BUSYBOX is not set
BR2_PACKAGE_LIBLO=y
BR2_PACKAGE_FFTW=y
BR2_PACKAGE_FFTW_SINGLE=y
BR2_PACKAGE_FFTW_DOUBLE=y
BR2_PACKAGE_FFTW_FAST=y
# BR2_TARGET_ROOTFS_TAR is not set
BR2_PACKAGE_KXSTUDIO_LV2_EXTENSIONS=y
BR2_PACKAGE_LIBMODLA=y
BR2_PACKAGE_LV2=y
BR2_PACKAGE_MOD_LV2_EXTENSIONS=y
BR2_PACKAGE_MOD_PLUGIN_BUILDER=y
```

## plugins-dep/configs/modduo-static_defconfig
```kconfig
BR2_arm=y
BR2_cortex_a7=y
BR2_ARM_FPU_NEON_VFPV4=y
BR2_ARM_INSTRUCTIONS_THUMB2=y
BR2_DL_DIR="$(DOWNLOAD_PATH)"
BR2_OPTIMIZE_3=y
BR2_SHARED_STATIC_LIBS=y
BR2_TOOLCHAIN_EXTERNAL=y
BR2_TOOLCHAIN_EXTERNAL_CUSTOM=y
BR2_TOOLCHAIN_EXTERNAL_PATH="$(TOOLCHAIN_PATH)"
BR2_TOOLCHAIN_EXTERNAL_CUSTOM_PREFIX="arm-mod-linux-gnueabihf.static"
BR2_TOOLCHAIN_EXTERNAL_GCC_7=y
BR2_TOOLCHAIN_EXTERNAL_HEADERS_3_10=y
BR2_TOOLCHAIN_EXTERNAL_CUSTOM_GLIBC=y
BR2_TOOLCHAIN_EXTERNAL_CXX=y
BR2_TARGET_OPTIMIZATION="-mcpu=cortex-a7 -mtune=cortex-a7 -mfpu=neon-vfpv4 -mfloat-abi=hard -mvectorize-with-neon-quad -ffast-math -fno-finite-math-only -fomit-frame-pointer -fprefetch-loop-arrays -ftree-vectorize -funroll-loops -funsafe-loop-optimizations -D__MOD_DEVICES__ -D_MOD_DEVICE_DUO -static-libstdc++ -Wl,-O1 -Wl,--as-needed -Wl,--strip-all"
BR2_TARGET_LDFLAGS="-static-libstdc++ -Wl,-O1 -Wl,--as-needed -Wl,--strip-all"
BR2_TARGET_GENERIC_HOSTNAME=""
BR2_TARGET_GENERIC_ISSUE=""
BR2_INIT_NONE=y
BR2_ROOTFS_DEVICE_CREATION_STATIC=y
BR2_ROOTFS_DEVICE_TABLE=""
BR2_ROOTFS_STATIC_DEVICE_TABLE=""
BR2_ROOTFS_SKELETON_CUSTOM=y
BR2_ROOTFS_SKELETON_CUSTOM_PATH="/tmp/skeleton"
# BR2_PACKAGE_BUSYBOX is not set
BR2_PACKAGE_LIBLO=y
BR2_PACKAGE_FFTW=y
BR2_PACKAGE_FFTW_SINGLE=y
BR2_PACKAGE_FFTW_DOUBLE=y
BR2_PACKAGE_FFTW_FAST=y
# BR2_TARGET_ROOTFS_TAR is not set
BR2_PACKAGE_JUCE6=y
BR2_PACKAGE_KXSTUDIO_LV2_EXTENSIONS=y
BR2_PACKAGE_LIBMODLA=y
BR2_PACKAGE_LV2=y
BR2_PACKAGE_MOD_LV2_EXTENSIONS=y
BR2_PACKAGE_MOD_PLUGIN_BUILDER=y
```

## plugins-dep/configs/modduo_defconfig
```kconfig
BR2_arm=y
BR2_cortex_a7=y
BR2_ARM_FPU_NEON_VFPV4=y
BR2_ARM_INSTRUCTIONS_THUMB2=y
BR2_DL_DIR="$(DOWNLOAD_PATH)"
BR2_OPTIMIZE_3=y
BR2_TOOLCHAIN_EXTERNAL=y
BR2_TOOLCHAIN_EXTERNAL_CUSTOM=y
BR2_TOOLCHAIN_EXTERNAL_PATH="$(TOOLCHAIN_PATH)"
BR2_TOOLCHAIN_EXTERNAL_CUSTOM_PREFIX="arm-mod-linux-gnueabihf"
BR2_TOOLCHAIN_EXTERNAL_GCC_4_9=y
BR2_TOOLCHAIN_EXTERNAL_HEADERS_3_10=y
BR2_TOOLCHAIN_EXTERNAL_CUSTOM_GLIBC=y
BR2_TOOLCHAIN_EXTERNAL_CXX=y
BR2_TARGET_OPTIMIZATION="-mcpu=cortex-a7 -mtune=cortex-a7 -mfpu=neon-vfpv4 -mfloat-abi=hard -mvectorize-with-neon-quad -ffast-math -fno-finite-math-only -fomit-frame-pointer -fprefetch-loop-arrays -ftree-vectorize -funroll-loops -funsafe-loop-optimizations -D__MOD_DEVICES__ -D_MOD_DEVICE_DUO -Wl,-O1 -Wl,--as-needed -Wl,--strip-all"
BR2_TARGET_LDFLAGS="-Wl,-O1 -Wl,--as-needed -Wl,--strip-all"
BR2_TARGET_GENERIC_HOSTNAME=""
BR2_TARGET_GENERIC_ISSUE=""
BR2_INIT_NONE=y
BR2_ROOTFS_DEVICE_CREATION_STATIC=y
BR2_ROOTFS_DEVICE_TABLE=""
BR2_ROOTFS_STATIC_DEVICE_TABLE=""
BR2_ROOTFS_SKELETON_CUSTOM=y
BR2_ROOTFS_SKELETON_CUSTOM_PATH="/tmp/skeleton"
# BR2_PACKAGE_BUSYBOX is not set
BR2_PACKAGE_QT5=y
BR2_PACKAGE_QT5BASE_LICENSE_APPROVED=y
BR2_PACKAGE_QT5BASE_ICU=y
BR2_PACKAGE_ALSA_LIB=y
BR2_PACKAGE_AUDIOFILE=y
BR2_PACKAGE_LIBLO=y
BR2_PACKAGE_LIBSAMPLERATE=y
BR2_PACKAGE_CAIRO=y
BR2_PACKAGE_CAIRO_PNG=y
BR2_PACKAGE_NE10=y
BR2_PACKAGE_LIBXML2=y
BR2_PACKAGE_MXML=y
BR2_PACKAGE_ARMADILLO=y
BR2_PACKAGE_BOOST_ATOMIC=y
BR2_PACKAGE_BOOST_CHRONO=y
BR2_PACKAGE_BOOST_CONTAINER=y
BR2_PACKAGE_BOOST_CONTEXT=y
BR2_PACKAGE_BOOST_DATE_TIME=y
BR2_PACKAGE_BOOST_EXCEPTION=y
BR2_PACKAGE_BOOST_FILESYSTEM=y
BR2_PACKAGE_BOOST_GRAPH=y
BR2_PACKAGE_BOOST_GRAPH_PARALLEL=y
BR2_PACKAGE_BOOST_IOSTREAMS=y
BR2_PACKAGE_BOOST_LOCALE=y
BR2_PACKAGE_BOOST_MATH=y
BR2_PACKAGE_BOOST_MPI=y
BR2_PACKAGE_BOOST_PROGRAM_OPTIONS=y
BR2_PACKAGE_BOOST_RANDOM=y
BR2_PACKAGE_BOOST_REGEX=y
BR2_PACKAGE_BOOST_SERIALIZATION=y
BR2_PACKAGE_BOOST_SIGNALS=y
BR2_PACKAGE_BOOST_SYSTEM=y
BR2_PACKAGE_BOOST_TEST=y
BR2_PACKAGE_BOOST_THREAD=y
BR2_PACKAGE_BOOST_TIMER=y
BR2_PACKAGE_BOOST_WAVE=y
BR2_PACKAGE_EIGEN=y
BR2_PACKAGE_FFTW=y
BR2_PACKAGE_FFTW_DOUBLE=y
BR2_PACKAGE_FFTW_FAST=y
BR2_PACKAGE_GLIBMM=y
BR2_PACKAGE_ACL=y
BR2_PACKAGE_UTIL_LINUX=y
BR2_PACKAGE_UTIL_LINUX_LIBMOUNT=y
# BR2_TARGET_ROOTFS_TAR is not set
BR2_PACKAGE_FLUIDSYNTH=y
BR2_PACKAGE_KXSTUDIO_LV2_EXTENSIONS=y
BR2_PACKAGE_LIBGIG=y
BR2_PACKAGE_LIBMODLA=y
BR2_PACKAGE_LILV=y
BR2_PACKAGE_LVTK=y
BR2_PACKAGE_LVTK_1=y
BR2_PACKAGE_MOD_LV2_EXTENSIONS=y
BR2_PACKAGE_MOD_PLUGIN_BUILDER=y
BR2_PACKAGE_ZITA_CONVOLVER=y
BR2_PACKAGE_ZITA_RESAMPLER=y
```

## plugins-dep/configs/modduox-new-debug_defconfig
```kconfig
BR2_aarch64=y
BR2_DL_DIR="$(DOWNLOAD_PATH)"
BR2_STRIP_none=y
BR2_OPTIMIZE_0=y
BR2_TOOLCHAIN_EXTERNAL=y
BR2_TOOLCHAIN_EXTERNAL_CUSTOM=y
BR2_TOOLCHAIN_EXTERNAL_PATH="$(TOOLCHAIN_PATH)"
BR2_TOOLCHAIN_EXTERNAL_CUSTOM_PREFIX="aarch64-modaudio-linux-gnueabi"
BR2_TOOLCHAIN_EXTERNAL_GCC_9=y
BR2_TOOLCHAIN_EXTERNAL_HEADERS_4_1=y
BR2_TOOLCHAIN_EXTERNAL_CUSTOM_GLIBC=y
# BR2_TOOLCHAIN_EXTERNAL_INET_RPC is not set
BR2_TOOLCHAIN_EXTERNAL_CXX=y
BR2_GENERATE_LOCALE="en_US.UTF-8"
BR2_TARGET_OPTIMIZATION="-mcpu=cortex-a53 -mtune=cortex-a53 -mfix-cortex-a53-835769 -mfix-cortex-a53-843419 -ffast-math -fno-finite-math-only -g -D__MOD_DEVICES__ -D_MOD_DEVICE_DUOX"
BR2_TARGET_LDFLAGS=""
BR2_TARGET_GENERIC_HOSTNAME=""
BR2_TARGET_GENERIC_ISSUE=""
BR2_INIT_NONE=y
BR2_ROOTFS_DEVICE_CREATION_STATIC=y
BR2_ROOTFS_DEVICE_TABLE=""
BR2_ROOTFS_STATIC_DEVICE_TABLE=""
BR2_ROOTFS_SKELETON_CUSTOM=y
BR2_ROOTFS_SKELETON_CUSTOM_PATH="/tmp/skeleton"
# BR2_PACKAGE_BUSYBOX is not set
BR2_PACKAGE_ALSA_LIB=y
BR2_PACKAGE_LIBLO=y
BR2_PACKAGE_FFTW=y
BR2_PACKAGE_FFTW_SINGLE=y
BR2_PACKAGE_FFTW_DOUBLE=y
BR2_PACKAGE_FFTW_FAST=y
# BR2_TARGET_ROOTFS_TAR is not set
BR2_PACKAGE_KXSTUDIO_LV2_EXTENSIONS=y
BR2_PACKAGE_LIBMODLA=y
BR2_PACKAGE_LV2=y
BR2_PACKAGE_MOD_LV2_EXTENSIONS=y
BR2_PACKAGE_MOD_PLUGIN_BUILDER=y
```

## plugins-dep/configs/modduox-static_defconfig
```kconfig
BR2_aarch64=y
BR2_DL_DIR="$(DOWNLOAD_PATH)"
BR2_OPTIMIZE_3=y
BR2_SHARED_STATIC_LIBS=y
BR2_TOOLCHAIN_EXTERNAL=y
BR2_TOOLCHAIN_EXTERNAL_CUSTOM=y
BR2_TOOLCHAIN_EXTERNAL_PATH="$(TOOLCHAIN_PATH)"
BR2_TOOLCHAIN_EXTERNAL_CUSTOM_PREFIX="aarch64-mod-linux-gnueabi.static"
BR2_TOOLCHAIN_EXTERNAL_GCC_7=y
BR2_TOOLCHAIN_EXTERNAL_HEADERS_4_4=y
BR2_TOOLCHAIN_EXTERNAL_CUSTOM_GLIBC=y
BR2_TOOLCHAIN_EXTERNAL_CXX=y
BR2_TARGET_OPTIMIZATION="-mcpu=cortex-a53 -mtune=cortex-a53 -mfix-cortex-a53-835769 -mfix-cortex-a53-843419 -ffast-math -fno-finite-math-only -fomit-frame-pointer -fprefetch-loop-arrays -ftree-vectorize -funroll-loops -funsafe-loop-optimizations -D__MOD_DEVICES__ -D_MOD_DEVICE_DUOX -static-libstdc++ -Wl,-O1 -Wl,--as-needed -Wl,--strip-all"
BR2_TARGET_LDFLAGS="-static-libstdc++ -Wl,-O1 -Wl,--as-needed -Wl,--strip-all"
BR2_TARGET_GENERIC_HOSTNAME=""
BR2_TARGET_GENERIC_ISSUE=""
BR2_INIT_NONE=y
BR2_ROOTFS_DEVICE_CREATION_STATIC=y
BR2_ROOTFS_DEVICE_TABLE=""
BR2_ROOTFS_STATIC_DEVICE_TABLE=""
BR2_ROOTFS_SKELETON_CUSTOM=y
BR2_ROOTFS_SKELETON_CUSTOM_PATH="/tmp/skeleton"
# BR2_PACKAGE_BUSYBOX is not set
BR2_PACKAGE_XORG7=y
BR2_PACKAGE_XLIB_LIBXCURSOR=y
BR2_PACKAGE_XLIB_LIBXINERAMA=y
BR2_PACKAGE_XLIB_LIBXRANDR=y
BR2_PACKAGE_ALSA_LIB=y
BR2_PACKAGE_LIBLO=y
BR2_PACKAGE_FFTW=y
BR2_PACKAGE_FFTW_SINGLE=y
BR2_PACKAGE_FFTW_DOUBLE=y
BR2_PACKAGE_FFTW_FAST=y
# BR2_TARGET_ROOTFS_TAR is not set
BR2_PACKAGE_JUCE=y
BR2_PACKAGE_KXSTUDIO_LV2_EXTENSIONS=y
BR2_PACKAGE_LIBMODLA=y
BR2_PACKAGE_LV2=y
BR2_PACKAGE_MOD_LV2_EXTENSIONS=y
BR2_PACKAGE_MOD_PLUGIN_BUILDER=y
```

## plugins-dep/configs/moddwarf_defconfig
```kconfig
BR2_aarch64=y
BR2_cortex_a35=y
BR2_DL_DIR="$(DOWNLOAD_PATH)"
BR2_OPTIMIZE_3=y
BR2_TOOLCHAIN_EXTERNAL=y
BR2_TOOLCHAIN_EXTERNAL_CUSTOM=y
BR2_TOOLCHAIN_EXTERNAL_PATH="$(TOOLCHAIN_PATH)"
BR2_TOOLCHAIN_EXTERNAL_CUSTOM_PREFIX="aarch64-mod-linux-gnu"
BR2_TOOLCHAIN_EXTERNAL_GCC_7=y
BR2_TOOLCHAIN_EXTERNAL_HEADERS_4_4=y
BR2_TOOLCHAIN_EXTERNAL_CUSTOM_GLIBC=y
BR2_TOOLCHAIN_EXTERNAL_CXX=y
BR2_GENERATE_LOCALE="en_US.UTF-8"
BR2_TARGET_OPTIMIZATION="-mcpu=cortex-a35 -mtune=cortex-a35 -ffast-math -fno-finite-math-only -D__MOD_DEVICES__ -D_MOD_DEVICE_DWARF"
BR2_TARGET_LDFLAGS="-Wl,-O1 -Wl,--as-needed -Wl,--strip-all"
BR2_TARGET_GENERIC_HOSTNAME=""
BR2_TARGET_GENERIC_ISSUE=""
BR2_INIT_NONE=y
BR2_ROOTFS_DEVICE_CREATION_STATIC=y
BR2_ROOTFS_DEVICE_TABLE=""
BR2_ROOTFS_STATIC_DEVICE_TABLE=""
BR2_ROOTFS_SKELETON_CUSTOM=y
BR2_ROOTFS_SKELETON_CUSTOM_PATH="/tmp/skeleton"
# BR2_PACKAGE_BUSYBOX is not set
BR2_PACKAGE_QT5=y
BR2_PACKAGE_QT5BASE_LICENSE_APPROVED=y
BR2_PACKAGE_QT5BASE_ICU=y
BR2_PACKAGE_LIBLO=y
BR2_PACKAGE_CAIRO=y
BR2_PACKAGE_CAIRO_PNG=y
BR2_PACKAGE_NE10=y
BR2_PACKAGE_LIBXML2=y
BR2_PACKAGE_MXML=y
BR2_PACKAGE_ARMADILLO=y
BR2_PACKAGE_BOOST_ATOMIC=y
BR2_PACKAGE_BOOST_CHRONO=y
BR2_PACKAGE_BOOST_CONTAINER=y
BR2_PACKAGE_BOOST_DATE_TIME=y
BR2_PACKAGE_BOOST_EXCEPTION=y
BR2_PACKAGE_BOOST_FILESYSTEM=y
BR2_PACKAGE_BOOST_GRAPH=y
BR2_PACKAGE_BOOST_GRAPH_PARALLEL=y
BR2_PACKAGE_BOOST_IOSTREAMS=y
BR2_PACKAGE_BOOST_LOCALE=y
BR2_PACKAGE_BOOST_MATH=y
BR2_PACKAGE_BOOST_MPI=y
BR2_PACKAGE_BOOST_PROGRAM_OPTIONS=y
BR2_PACKAGE_BOOST_RANDOM=y
BR2_PACKAGE_BOOST_REGEX=y
BR2_PACKAGE_BOOST_SERIALIZATION=y
BR2_PACKAGE_BOOST_SIGNALS=y
BR2_PACKAGE_BOOST_SYSTEM=y
BR2_PACKAGE_BOOST_TEST=y
BR2_PACKAGE_BOOST_THREAD=y
BR2_PACKAGE_BOOST_TIMER=y
BR2_PACKAGE_BOOST_WAVE=y
BR2_PACKAGE_EIGEN=y
BR2_PACKAGE_FFTW=y
BR2_PACKAGE_FFTW_DOUBLE=y
BR2_PACKAGE_GLIBMM=y
BR2_PACKAGE_ACL=y
BR2_PACKAGE_UTIL_LINUX=y
BR2_PACKAGE_UTIL_LINUX_LIBMOUNT=y
BR2_PACKAGE_DPF=y
BR2_PACKAGE_FLUIDSYNTH=y
BR2_PACKAGE_JACK2MOD=y
BR2_PACKAGE_LIBGIG=y
BR2_PACKAGE_LIBMODLA=y
BR2_PACKAGE_LIBPD=y
BR2_PACKAGE_LILV=y
BR2_PACKAGE_LVTK=y
BR2_PACKAGE_LVTK_1=y
BR2_PACKAGE_ZITA_CONVOLVER=y
BR2_PACKAGE_ZITA_RESAMPLER=y
```

## plugins-dep/package-legacy/lvtk/Config.in
```kconfig
config BR2_PACKAGE_LVTK
	bool "lvtk"
	select BR2_PACKAGE_BOOST
	select BR2_PACKAGE_LV2
```

## plugins-dep/package-legacy/sord/Config.in
```kconfig
config BR2_PACKAGE_SORD
	bool "sord"
	select BR2_PACKAGE_PCRE if BR2_VERSION_2016_02
	select BR2_PACKAGE_SERD
```
